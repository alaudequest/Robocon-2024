# file: Test_OptimizerV2.ioc
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Mcu.Family=STM32F1
Mcu.Name=STM32F103C(8-B)Tx
Mcu.Package=LQFP48
NVIC.PriorityGroup=NVIC_PRIORITYGROUP_4
PA13.Mode=Serial_Wire
PA13.Signal=SYS_JTMS-SWDIO
PA14.Mode=Serial_Wire
PA14.Signal=SYS_JTCK-SWCLK
ProjectManager.HeapSize=0x200
ProjectManager.StackSize=0x400
ProjectManager.TargetToolchain=STM32CubeIDE
RCC.APB1Freq_Value=8000000
RCC.APB2Freq_Value=8000000
board=custom

// file: Core/Src/main.c
/* USER CODE BEGIN Header */
/**
  ******************************************************************************
  * @file           : main.c
  * @brief          : Main program body
  ******************************************************************************
  * @attention
  *
  * Copyright (c) 2023 STMicroelectronics.
  * All rights reserved.
  *
  * This software is licensed under terms that can be found in the LICENSE file
  * in the root directory of this software component.
  * If no LICENSE file comes with this software, it is provided AS-IS.
  *
  ******************************************************************************
  */
/* USER CODE END Header */
#include "main.h"

/* USER CODE BEGIN Includes */
#include "math.h"
#include "stdlib.h"
/* USER CODE END Includes */

void SystemClock_Config(void);
static void MX_GPIO_Init(void);
/* USER CODE BEGIN PFP */
float AngleTest;
typedef struct Optimizer{
	int8_t Direc;
	float CurAngle;
	float PreAngle;
	float CalInput;
	float CalX;
	float CalY;
	float PreX;
	float PreY;
	float Alpha;
	float X;
	float Y;
}Optimizer;
void SwerveInit(Optimizer *Swerve) {
	Swerve->Direc = 1;
	Swerve->CalInput = 0;
	Swerve->CurAngle = 0;
	Swerve->PreAngle = 0;
	Swerve->Alpha = 0;
	Swerve->CalX = 0;
	Swerve->CalY = 0;
	Swerve->PreX = 1;
	Swerve->PreY = 0;
	Swerve->X = 1;
	Swerve->Y = 0;
}
Optimizer Swerve;
void OptimizerV2(Optimizer *Swerve, float Input) {
	if(Input != Swerve->PreAngle) {
		Swerve->CalInput = Input * M_PI/180;
		Swerve->CalX = Swerve->X*cos(Swerve->CalInput) - Swerve->Y*sin(Swerve->CalInput);
		Swerve->CalY = Swerve->X*sin(Swerve->CalInput) + Swerve->Y*cos(Swerve->CalInput);
		Swerve->Alpha = acos(((Swerve->CalX*Swerve->PreX) + (Swerve->CalY*Swerve->PreY))/(sqrt((Swerve->CalX*Swerve->CalX)+(Swerve->CalY*Swerve->CalY))*sqrt((Swerve->PreX*Swerve->PreX)+(Swerve->PreY*Swerve->PreY))))*(180/M_PI);
		Swerve->PreX = Swerve->CalX;
		Swerve->PreY = Swerve->CalY;
		if(Swerve->Alpha == 0) {
			Swerve->Direc *= 1;
			if(Input == Swerve->CurAngle + 360) Swerve->CurAngle = Input - 360;
			else if(Input == Swerve->CurAngle - 360) Swerve->CurAngle = Input + 360;
		}
		else if(Swerve->Alpha == 180) {
			Swerve->Direc *= -1;
			if(Input == Swerve->CurAngle + 180) Swerve->CurAngle = Input - 180;
			else if(Input == Swerve->CurAngle - 180) Swerve->CurAngle = Input +  180;
		}
		else if(Swerve->Alpha <= 90) {
			if(Swerve->CurAngle>=0 && Swerve->CurAngle<=90) {
				if(Input>=-90 && Input<=90) {
					if(Swerve->PreAngle>=0 && Swerve->PreAngle<=90) Swerve->Direc *= 1;
					else Swerve->Direc *= -1;
					Swerve->CurAngle = Input;
				}
				else if(Input>90 && Input<=180) {
					Swerve->Direc *= -1;
					Swerve->CurAngle = Input - 180;
				}
				else if(Input>=270 && Input<=360) {
					if(Swerve->PreAngle>=0 && Swerve->PreAngle<=90) Swerve->Direc *= 1;
					else Swerve->Direc *= -1;
					Swerve->CurAngle = Input - 360;
				}
				else if(Input>=-360 && Input<=-270) {
					if(Swerve->PreAngle>=0 && Swerve->PreAngle<=90) Swerve->Direc *= 1;
					else Swerve->Direc *= -1;
					Swerve->CurAngle = Input + 360;
				}
				else if(Input>=-180 && Input<-90) {
					Swerve->Direc *= -1;
					Swerve->CurAngle = Input + 180;
				}
			}
			else if(Swerve->CurAngle>=-90 && Swerve->CurAngle<=0) {
				if(Input>=-90 && Input<=90) {
					if(Swerve->PreAngle>=-90 && Swerve->PreAngle<0) Swerve->Direc *= 1;
					else Swerve->Direc *= -1;
					Swerve->CurAngle = Input;
				}
				else if(Input>=-180 && Input<-90) {
					Swerve->Direc *= -1;
					Swerve->CurAngle = Input + 180;
				}
				else if(Input>=-360 && Input<=-270) {
					if(Swerve->PreAngle>=-90 && Swerve->PreAngle<0) Swerve->Direc *= 1;
					else Swerve->Direc *= -1;
					Swerve->CurAngle = Input + 360;
				}
				else if(Input>=270 && Input<=360) {
					if(Swerve->PreAngle>=-90 && Swerve->PreAngle<0) Swerve->Direc *= 1;
					else Swerve->Direc *= -1;
					Swerve->CurAngle = Input - 360;
				}
				else if(Input>90 && Input<=180) {
					Swerve->Direc *= -1;
					Swerve->CurAngle = Input - 180;
				}
			}
		}
		else if(Swerve->Alpha>90 && Swerve->Alpha<180) {
			if(Swerve->CurAngle>=0 && Swerve->CurAngle<=90) {
				if(Input>90 && Input<=270) {
					Swerve->Direc *= -1;
					Swerve->CurAngle = Input - 180;
				}
				else if(Input>=270 && Input<=360) {
					if(Swerve->PreAngle>=0 && Swerve->PreAngle<=90) Swerve->Direc *= 1;
					else Swerve->Direc *= -1;
					Swerve->CurAngle = Input - 360;
				}
				else if(Input>=-90 && Input<=90) {
					Swerve->CurAngle = Input;
					if(Swerve->PreAngle>=0 && Swerve->PreAngle<=90) Swerve->Direc *= 1;
					else Swerve->Direc *= -1;
				}
				else if(Input>=-270 && Input<-90) {
					Swerve->Direc *= -1;
					Swerve->CurAngle = Input + 180;
				}
				else if(Input>=-360 && Input<=-270) {
					if(Swerve->PreAngle>=0 && Swerve->PreAngle<=90) Swerve->Direc *= 1;
					else Swerve->Direc *= -1;
					Swerve->CurAngle = Input + 360;
				}
			}
			else if(Swerve->CurAngle>=-90 && Swerve->CurAngle<0) {
				if((Input>=-270 && Input<-90) || (Input>90 && Input<=270) ) {
					Swerve->Direc *= -1;
					if(Input>90 && Input<=270) Swerve->CurAngle = Input - 180;
					else Swerve->CurAngle = Input + 180;
				}
				else if((Input>=-360 && Input<=-270) || (Input>=-90 && Input<=90)) {
					if(Swerve->PreAngle>=-90 && Swerve->PreAngle<0) Swerve->Direc *= 1;
					else Swerve->Direc *= -1;
					if((Input>=-360 && Input<=-270)) Swerve->CurAngle = Input + 360;
					else Swerve->CurAngle = Input;
				}
//				else if(Input>=-90 && Input<=90) {
//					if(Swerve->PreAngle>=-90 && Swerve->PreAngle<0) Swerve->Direc *= 1;
//					else Swerve->Direc *= -1;
//					Swerve->CurAngle = Input;
//				}
//				else if(Input>90 && Input<=270) {
//					Swerve->Direc *= -1;
//					Swerve->CurAngle = Input - 180;
//				}
			}
		}
		Swerve->PreAngle = Input;
	}
}
/* USER CODE END PFP */

int main(void)
{

  /* MCU Configuration--------------------------------------------------------*/

  /* Reset of all peripherals, Initializes the Flash interface and the Systick. */
  HAL_Init();

  /* Configure the system clock */
  SystemClock_Config();

  /* Initialize all configured peripherals */
  MX_GPIO_Init();
  /* USER CODE BEGIN 2 */
  SwerveInit(&Swerve);
  /* USER CODE END 2 */

  /* Infinite loop */
  /* USER CODE BEGIN WHILE */
  while (1)
  {
	 OptimizerV2(&Swerve, AngleTest);
    /* USER CODE END WHILE */

  }
}

void SystemClock_Config(void)
{
  RCC_OscInitTypeDef RCC_OscInitStruct = {0};
  RCC_ClkInitTypeDef RCC_ClkInitStruct = {0};

  /** Initializes the RCC Oscillators according to the specified parameters
  * in the RCC_OscInitTypeDef structure.
  */
  RCC_OscInitStruct.OscillatorType = RCC_OSCILLATORTYPE_HSI;
  RCC_OscInitStruct.HSIState = RCC_HSI_ON;
  RCC_OscInitStruct.HSICalibrationValue = RCC_HSICALIBRATION_DEFAULT;
  RCC_OscInitStruct.PLL.PLLState = RCC_PLL_NONE;
  if (HAL_RCC_OscConfig(&RCC_OscInitStruct) != HAL_OK)
  {
    Error_Handler();
  }

  /** Initializes the CPU, AHB and APB buses clocks
  */
  RCC_ClkInitStruct.ClockType = RCC_CLOCKTYPE_HCLK|RCC_CLOCKTYPE_SYSCLK
                              |RCC_CLOCKTYPE_PCLK1|RCC_CLOCKTYPE_PCLK2;
  RCC_ClkInitStruct.SYSCLKSource = RCC_SYSCLKSOURCE_HSI;
  RCC_ClkInitStruct.AHBCLKDivider = RCC_SYSCLK_DIV1;
  RCC_ClkInitStruct.APB1CLKDivider = RCC_HCLK_DIV1;
  RCC_ClkInitStruct.APB2CLKDivider = RCC_HCLK_DIV1;

  if (HAL_RCC_ClockConfig(&RCC_ClkInitStruct, FLASH_LATENCY_0) != HAL_OK)
  {
    Error_Handler();
  }
}

static void MX_GPIO_Init(void)
{

  /* GPIO Ports Clock Enable */
  __HAL_RCC_GPIOA_CLK_ENABLE();

}

void Error_Handler(void)
{
  __disable_irq();
  while (1)
  {
  }
}

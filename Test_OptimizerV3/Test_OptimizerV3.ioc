# file: Test_OptimizerV3.ioc
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Mcu.Family=STM32F1
Mcu.Name=STM32F103C(8-B)Tx
Mcu.Package=LQFP48
NVIC.PriorityGroup=NVIC_PRIORITYGROUP_4
PA13.Mode=Serial_Wire
PA13.Signal=SYS_JTMS-SWDIO
PA14.Mode=Serial_Wire
PA14.Signal=SYS_JTCK-SWCLK
PD0-OSC_IN.Mode=HSE-External-Oscillator
PD0-OSC_IN.Signal=RCC_OSC_IN
PD1-OSC_OUT.Mode=HSE-External-Oscillator
PD1-OSC_OUT.Signal=RCC_OSC_OUT
ProjectManager.HeapSize=0x200
ProjectManager.StackSize=0x400
ProjectManager.TargetToolchain=STM32CubeIDE
RCC.AHBFreq_Value=72000000
RCC.APB1CLKDivider=RCC_HCLK_DIV2
RCC.APB1Freq_Value=36000000
RCC.APB1TimFreq_Value=72000000
RCC.APB2Freq_Value=72000000
RCC.APB2TimFreq_Value=72000000
RCC.HCLKFreq_Value=72000000
RCC.PLLMUL=RCC_PLL_MUL9
RCC.PLLSourceVirtual=RCC_PLLSOURCE_HSE
RCC.SYSCLKFreq_VALUE=72000000
RCC.SYSCLKSource=RCC_SYSCLKSOURCE_PLLCLK
RCC.USBFreq_Value=72000000
board=custom

// file: Core/Src/main.c
/* USER CODE BEGIN Header */
/**
  ******************************************************************************
  * @file           : main.c
  * @brief          : Main program body
  ******************************************************************************
  * @attention
  *
  * Copyright (c) 2023 STMicroelectronics.
  * All rights reserved.
  *
  * This software is licensed under terms that can be found in the LICENSE file
  * in the root directory of this software component.
  * If no LICENSE file comes with this software, it is provided AS-IS.
  *
  ******************************************************************************
  */
/* USER CODE END Header */
#include "main.h"

/* USER CODE BEGIN Includes */
#include "math.h"
#include "stdlib.h"
/* USER CODE END Includes */

void SystemClock_Config(void);
static void MX_GPIO_Init(void);

/* USER CODE BEGIN 0 */
float AngleTest;

typedef struct Optimizer {
	int8_t Direc;
	float CurAngle;
	float PreAngle;
	float DeltaAngle;
	float CalInput;
	float CalX;
	float CalY;
	float PreX;
	float PreY;
	float Alpha;
	int8_t X;
	int8_t Y;
}Optimizer;

Optimizer Swerve;

void SwerveInit(Optimizer *Swerve) {
	Swerve->Direc 		= 1;
	Swerve->CurAngle 	= 0;
	Swerve->PreAngle	= 0;
	Swerve->DeltaAngle	= 0;
	Swerve->CalInput 	= 0;
	Swerve->CalX		= 0;
	Swerve->CalY		= 0;
	Swerve->PreX		= 1;
	Swerve->PreY		= 0;
	Swerve->Alpha 		= 0;
	Swerve->X			= 1;
	Swerve->Y			= 0;
}

void OptimizerV3(Optimizer *Swerve, float Input){
	if(Input != Swerve->PreAngle) {
		Swerve->CalInput   = Input*M_PI/180;
		Swerve->CalX 	   = Swerve->X*cos(Swerve->CalInput) - Swerve->Y*sin(Swerve->CalInput);
		Swerve->CalY 	   = Swerve->X*sin(Swerve->CalInput) + Swerve->Y*cos(Swerve->CalInput);
		Swerve->Alpha 	   = acos(((Swerve->PreX*Swerve->CalX)+(Swerve->PreY*Swerve->CalY))/(sqrt((Swerve->CalX*Swerve->CalX)+(Swerve->CalY*Swerve->CalY))*sqrt((Swerve->PreX*Swerve->PreX)+(Swerve->PreY*Swerve->PreY))))*(180/M_PI);
		Swerve->PreX 	   = Swerve->CalX;
		Swerve->PreY 	   = Swerve->CalY;
		Swerve->PreAngle   = Input;
		Swerve->DeltaAngle = abs(Swerve->CurAngle-Swerve->PreAngle);
//		if(Swerve->CurAngle>=(360*3)){
			if(Swerve->Alpha == 0){
				if(Input == (Swerve->CurAngle+360)) Swerve->CurAngle=Input-360;
				else if(Input==(Swerve->CurAngle-360))Swerve->CurAngle=Input+360;
			}
			else if(Swerve->Alpha==180){
				Swerve->Direc *= -1;
				if(Input==(Swerve->CurAngle+180)) Swerve->CurAngle=Input-180;
				else if(Input==(Swerve->CurAngle-180)) Swerve->CurAngle=Input+180;
			}
			else if(Swerve->Alpha<=90) {
				if(Swerve->DeltaAngle<=90){
					Swerve->Direc = 1;
					Swerve->CurAngle=Input;
				}
				else if(Swerve->DeltaAngle<=180 && Swerve->CurAngle>=0){
					Swerve->Direc=-1;
					if(Input>0) Swerve->CurAngle=Input-180;
					else Swerve->CurAngle=Input+180;
				}
				else if(Swerve->DeltaAngle<=180 && Swerve->CurAngle<=0){
					Swerve->Direc=-1;
					if(Input>=0) Swerve->CurAngle=Input-180;
					else Swerve->CurAngle=Input+180;
				}
				else if(Swerve->DeltaAngle<=270 && Swerve->CurAngle>=0){
					Swerve->Direc=-1;
					if(Input>0) Swerve->CurAngle=Input-180;
					else Swerve->CurAngle=Input+180;
				}
				else if(Swerve->DeltaAngle<=270 && Swerve->CurAngle<=0){
					Swerve->Direc=-1;
					if(Input>=0) Swerve->CurAngle=Input-180;
					else Swerve->CurAngle=Input+180;
				}
				else if(Swerve->DeltaAngle>270){
					Swerve->Direc=-1;
					if(Input>=0) Swerve->CurAngle=Input-180*3;
					else Swerve->CurAngle=(180*3+Input);
				}
			}
			else if(Swerve->Alpha>=90) {
				if(Swerve->DeltaAngle<=90) {
					Swerve->CurAngle= Input;
					Swerve->Direc = 1;
				}
				else if(Swerve->CurAngle>=0 && Swerve->DeltaAngle<=180) {
					if(Input>0)Swerve->CurAngle=Input-180;
					else Swerve->CurAngle=Input+180;
					Swerve->Direc = -1;
				}
				else if(Swerve->CurAngle<=0 && Swerve->DeltaAngle<=180) {
					if(Input>=0)Swerve->CurAngle=Input-180;
					else Swerve->CurAngle=Input+180;
					Swerve->Direc = -1;
				}

				else if(Swerve->CurAngle<=0 && Swerve->DeltaAngle<=270) {
					if(Input>=0)Swerve->CurAngle=Input-180;
					else Swerve->CurAngle=Input+180;
					Swerve->Direc = -1;
				}
				else if(Swerve->CurAngle>=0 && Swerve->DeltaAngle<=270) {
					if(Input>=0)Swerve->CurAngle=180-Input;
					else Swerve->CurAngle=Input+180;
					Swerve->Direc = -1;
				}
				else if(Swerve->CurAngle>=0 && Swerve->DeltaAngle>270) {
					if(Input>=0)Swerve->CurAngle=Input-360;
					else Swerve->CurAngle=Input+360;
					Swerve->Direc=1;
				}
				else if(Swerve->CurAngle<=0 && Swerve->DeltaAngle>270) {
					if(Input>=0)Swerve->CurAngle=Input-360;
					else Swerve->CurAngle=Input+360;
					Swerve->Direc=1;
				}
			}
//		}
//		else{
//			Swerve->Direc=1;
//			Swerve->CurAngle=Input;
//		}
	}
}
/* USER CODE END 0 */

int main(void)
{

  /* MCU Configuration--------------------------------------------------------*/

  /* Reset of all peripherals, Initializes the Flash interface and the Systick. */
  HAL_Init();

  /* Configure the system clock */
  SystemClock_Config();

  /* Initialize all configured peripherals */
  MX_GPIO_Init();
  /* USER CODE BEGIN 2 */
  SwerveInit(&Swerve);
  /* USER CODE END 2 */

  /* Infinite loop */
  /* USER CODE BEGIN WHILE */
  while (1)
  {
	OptimizerV3(&Swerve, AngleTest);
	HAL_Delay(10);
    /* USER CODE END WHILE */

  }
}

void SystemClock_Config(void)
{
  RCC_OscInitTypeDef RCC_OscInitStruct = {0};
  RCC_ClkInitTypeDef RCC_ClkInitStruct = {0};

  /** Initializes the RCC Oscillators according to the specified parameters
  * in the RCC_OscInitTypeDef structure.
  */
  RCC_OscInitStruct.OscillatorType = RCC_OSCILLATORTYPE_HSE;
  RCC_OscInitStruct.HSEState = RCC_HSE_ON;
  RCC_OscInitStruct.HSEPredivValue = RCC_HSE_PREDIV_DIV1;
  RCC_OscInitStruct.HSIState = RCC_HSI_ON;
  RCC_OscInitStruct.PLL.PLLState = RCC_PLL_ON;
  RCC_OscInitStruct.PLL.PLLSource = RCC_PLLSOURCE_HSE;
  RCC_OscInitStruct.PLL.PLLMUL = RCC_PLL_MUL9;
  if (HAL_RCC_OscConfig(&RCC_OscInitStruct) != HAL_OK)
  {
    Error_Handler();
  }

  /** Initializes the CPU, AHB and APB buses clocks
  */
  RCC_ClkInitStruct.ClockType = RCC_CLOCKTYPE_HCLK|RCC_CLOCKTYPE_SYSCLK
                              |RCC_CLOCKTYPE_PCLK1|RCC_CLOCKTYPE_PCLK2;
  RCC_ClkInitStruct.SYSCLKSource = RCC_SYSCLKSOURCE_PLLCLK;
  RCC_ClkInitStruct.AHBCLKDivider = RCC_SYSCLK_DIV1;
  RCC_ClkInitStruct.APB1CLKDivider = RCC_HCLK_DIV2;
  RCC_ClkInitStruct.APB2CLKDivider = RCC_HCLK_DIV1;

  if (HAL_RCC_ClockConfig(&RCC_ClkInitStruct, FLASH_LATENCY_2) != HAL_OK)
  {
    Error_Handler();
  }
}

static void MX_GPIO_Init(void)
{

  /* GPIO Ports Clock Enable */
  __HAL_RCC_GPIOD_CLK_ENABLE();
  __HAL_RCC_GPIOA_CLK_ENABLE();

}

void Error_Handler(void)
{
  __disable_irq();
  while (1)
  {
  }
}
